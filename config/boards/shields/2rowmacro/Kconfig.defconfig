## config/boards/shields/2rowmacro/Kconfig.defconfig
```kconfig
if SHIELD_2ROWMACRO

config ZMK_KEYBOARD_NAME
    default "2rowmacro"

endif

CONFIG_ZMK_EXT_POWER=y
CONFIG_ZMK_IDLE_TIMEOUT=15000
CONFIG_ZMK_SLEEP=y
CONFIG_ZMK_IDLE_SLEEP_TIMEOUT=300000
```
